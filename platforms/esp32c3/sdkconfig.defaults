## platforms/esp32c3/sdkconfig.defaults
```kconfig
# Overrides applied over defconfig
# Additional changes can be made via ESP_IDF_SDKCONFIG_OPTS

CONFIG_PARTITION_TABLE_SINGLE_APP=n
CONFIG_PARTITION_TABLE_CUSTOM=y
CONFIG_PARTITION_TABLE_CUSTOM_FILENAME="../esp32xx/partitions_mgos.csv"
CONFIG_PARTITION_TABLE_FILENAME="../esp32xx/partitions_mgos.csv"
CONFIG_COMPILER_OPTIMIZATION_SIZE=y
CONFIG_COMPILER_CXX_EXCEPTIONS=n
CONFIG_COMPILER_CXX_RTTI=n

CONFIG_ESP_COREDUMP_ENABLE_TO_UART=y
CONFIG_ESP_COREDUMP_ENABLE_TO_NONE=n
CONFIG_ESP_COREDUMP_ENABLE=y
CONFIG_ESP_COREDUMP_UART_DELAY=0
CONFIG_ESP_COREDUMP_LOG_LEVEL=1
CONFIG_ESP_SYSTEM_EVENT_TASK_STACK_SIZE=4096
CONFIG_ESP_TASK_WDT_PANIC=y

CONFIG_FREERTOS_USE_TRACE_FACILITY=y
CONFIG_FREERTOS_CHECK_STACKOVERFLOW_NONE=y
CONFIG_FREERTOS_CHECK_STACKOVERFLOW_CANARY=n
CONFIG_FREERTOS_WATCHPOINT_END_OF_STACK=y
CONFIG_FREERTOS_BREAK_ON_SCHEDULER_START_JTAG=y
CONFIG_FREERTOS_TIMER_TASK_STACK_DEPTH=4096
CONFIG_LWIP_DHCP_DOES_ARP_CHECK=n
CONFIG_LWIP_TCPIP_TASK_STACK_SIZE=4096

# NB: Flash frequency must match ROM flash frequency set in the boot loader parameters
# otherwise encrypted writes fail.
# https://github.com/espressif/esp-idf/issues/6322
CONFIG_ESPTOOLPY_FLASHFREQ="80m"
CONFIG_ESPTOOLPY_FLASHFREQ_80M=y
CONFIG_ESPTOOLPY_FLASHMODE="qio"
CONFIG_ESPTOOLPY_FLASHMODE_QIO=y
CONFIG_ESPTOOLPY_FLASHSIZE="4MB"
CONFIG_ESPTOOLPY_FLASHSIZE_4MB=y
# SPIRAM frequency, if enabled, must also match the flash frequency.
CONFIG_SPIRAM_SPEED_80M=y

CONFIG_ESP_NETIF_TCPIP_ADAPTER_COMPATIBLE_LAYER=n

# Required to be able to update boot loader.
CONFIG_SPI_FLASH_DANGEROUS_WRITE_ALLOWED=y

# Disable use of RTC for timekeeping for now. It flakes out sometimes.
CONFIG_ESP32C3_TIME_SYSCALL_USE_SYSTIMER=y
CONFIG_ESP32C3_TIME_SYSCALL_USE_RTC_SYSTIMER=n

# Disable WiFi by default. Enabled by the lib.
CONFIG_ESP32_WIFI_ENABLED=n

# Stop wpa-supplicant from building custom crypto.
CONFIG_MBEDTLS_CCM_C=y
CONFIG_MBEDTLS_CMAC_C=y
CONFIG_MBEDTLS_NIST_KW_C=y

# App-specific settings below.
```
